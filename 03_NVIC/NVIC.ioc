# file: NVIC.ioc
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Mcu.Family=STM32F4
Mcu.Name=STM32F407V(E-G)Tx
Mcu.Package=LQFP100
NVIC.EXTI0_IRQn=true\:0\:0\:false\:false\:true\:true\:true\:true
NVIC.PriorityGroup=NVIC_PRIORITYGROUP_4
PA0-WKUP.GPIO_Label=Key
PA0-WKUP.Signal=GPXTI0
ProjectManager.HeapSize=0x200
ProjectManager.StackSize=0x400
ProjectManager.TargetToolchain=STM32CubeIDE
RCC.AHBFreq_Value=16000000
RCC.APB1Freq_Value=16000000
RCC.APB2Freq_Value=16000000
RCC.CortexFreq_Value=16000000
RCC.HSE_VALUE=25000000
RCC.HSI_VALUE=16000000
RCC.LSE_VALUE=32768
RCC.SYSCLKFreq_VALUE=16000000
RCC.VCOOutputFreq_Value=192000000
board=custom

// file: Core/Src/main.c
/* USER CODE BEGIN Header */
/**
  ******************************************************************************
  * @file           : main.c
  * @brief          : Main program body
  ******************************************************************************
  * @attention
  *
  * Copyright (c) 2023 STMicroelectronics.
  * All rights reserved.
  *
  * This software is licensed under terms that can be found in the LICENSE file
  * in the root directory of this software component.
  * If no LICENSE file comes with this software, it is provided AS-IS.
  *
  ******************************************************************************
  */
/* USER CODE END Header */
#include "main.h"

/* USER CODE BEGIN PV */

int red = 14;
int green = 12; // 12 for F407   13 for F429
int button_CNT = 0; // подсчет кнопки
__IO uint32_t green_on_CNT = 0, green_period_CNT = 0; // счетчики таймера
/* USER CODE END PV */

void SystemClock_Config(void);
static void MX_GPIO_Init(void);
/* USER CODE BEGIN PFP */

// Control LED
void MyWriteLed(int pin_num, int sign)
{
	GPIOD->BSRR |= sign ? (1 << pin_num) : (1 << (pin_num + 16));
}

void SysTick_Handler() // запускается каждую мс
{
	button_CNT += GPIOA->IDR & 0x1; // дребезг
	// декрементирование счетчиков
	if(green_on_CNT > 0)
		green_on_CNT--;
	if(green_period_CNT > 0)
	{
		green_period_CNT--;
		button_CNT = 0;
	}
}

void EXTI0_IRQHandler(void) {
	if(__HAL_GPIO_EXTI_GET_IT(Key_Pin) != RESET)
	  {
	    __HAL_GPIO_EXTI_CLEAR_IT(Key_Pin);
	    button_CNT = 0;
	  }
}

/* USER CODE END PFP */

int main(void)
{
  /* USER CODE BEGIN 1 */
	RCC->AHB1ENR |= (1 << 3) + 1; // GPIOA and GPIOD (3) clocking  //  GPIOA and GPIOG (6) for F429
	GPIOA->MODER &= ~3; // PA0 to 00
	GPIOD->MODER &= ~( (1 << (2 * 14 + 1)) + (1 << (2 * 12 + 1)) ); // PD12, PD14 to 0_ for F407 // PG13, PG14 for F429
	GPIOD->MODER |= (1 << (2 * 14)) + (1 << (2 * 12)); // PD12, PD14 to 01 for F407 // PG13, PG14 for F429
  /* USER CODE END 1 */

  /* MCU Configuration--------------------------------------------------------*/

  /* Reset of all peripherals, Initializes the Flash interface and the Systick. */
  HAL_Init();

  /* Configure the system clock */
   SystemClock_Config();

  /* Initialize all configured peripherals */
  MX_GPIO_Init();

  /* Infinite loop */
  /* USER CODE BEGIN WHILE */
  while (1)
  /* USER CODE END 3 */
  {
	if(button_CNT > 100) {
		button_CNT = 0;
		if(!green_period_CNT)
			MyWriteLed(red, 0); //red off
			MyWriteLed(green, 1); // green on
			green_on_CNT = 2000; // 2000 ms green delay
			green_period_CNT = 4000; // 4000 ms to next green
	}
	if(!green_on_CNT) {
		MyWriteLed(green, 0); // green off
		MyWriteLed(red, 1); // red on
	}

    /* USER CODE END WHILE */

    /* USER CODE BEGIN 3 */
  }
}

void SystemClock_Config(void)
{
  RCC_OscInitTypeDef RCC_OscInitStruct = {0};
  RCC_ClkInitTypeDef RCC_ClkInitStruct = {0};

  /** Configure the main internal regulator output voltage
  */
  __HAL_RCC_PWR_CLK_ENABLE();
  __HAL_PWR_VOLTAGESCALING_CONFIG(PWR_REGULATOR_VOLTAGE_SCALE1);

  /** Initializes the RCC Oscillators according to the specified parameters
  * in the RCC_OscInitTypeDef structure.
  */
  RCC_OscInitStruct.OscillatorType = RCC_OSCILLATORTYPE_HSI;
  RCC_OscInitStruct.HSIState = RCC_HSI_ON;
  RCC_OscInitStruct.HSICalibrationValue = RCC_HSICALIBRATION_DEFAULT;
  RCC_OscInitStruct.PLL.PLLState = RCC_PLL_NONE;
  if (HAL_RCC_OscConfig(&RCC_OscInitStruct) != HAL_OK)
  {
    Error_Handler();
  }

  /** Initializes the CPU, AHB and APB buses clocks
  */
  RCC_ClkInitStruct.ClockType = RCC_CLOCKTYPE_HCLK|RCC_CLOCKTYPE_SYSCLK
                              |RCC_CLOCKTYPE_PCLK1|RCC_CLOCKTYPE_PCLK2;
  RCC_ClkInitStruct.SYSCLKSource = RCC_SYSCLKSOURCE_HSI;
  RCC_ClkInitStruct.AHBCLKDivider = RCC_SYSCLK_DIV1;
  RCC_ClkInitStruct.APB1CLKDivider = RCC_HCLK_DIV1;
  RCC_ClkInitStruct.APB2CLKDivider = RCC_HCLK_DIV1;

  if (HAL_RCC_ClockConfig(&RCC_ClkInitStruct, FLASH_LATENCY_0) != HAL_OK)
  {
    Error_Handler();
  }
}

static void MX_GPIO_Init(void)
{
  GPIO_InitTypeDef GPIO_InitStruct = {0};

  /* GPIO Ports Clock Enable */
  __HAL_RCC_GPIOA_CLK_ENABLE();

  /*Configure GPIO pin : Key_Pin */
  GPIO_InitStruct.Pin = Key_Pin;
  GPIO_InitStruct.Mode = GPIO_MODE_IT_RISING;
  GPIO_InitStruct.Pull = GPIO_NOPULL;
  HAL_GPIO_Init(Key_GPIO_Port, &GPIO_InitStruct);

  /* EXTI interrupt init*/
  HAL_NVIC_SetPriority(EXTI0_IRQn, 0, 0);
  HAL_NVIC_EnableIRQ(EXTI0_IRQn);

}

void Error_Handler(void)
{
  __disable_irq();
  while (1)
  {
  }
}
